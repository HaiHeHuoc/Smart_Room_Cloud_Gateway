## components/application/afe_pipeline/Kconfig
```kconfig
menu "AFE pipeline WakeNet and VAD proof"

config AFE_PIPELINE_ENABLE
    bool "Enable continuous ESP-SR AFE WakeNet and VAD proof"
    default n
    depends on IDF_TARGET_ESP32S3 && SR_WN_WN9_HIESP
    help
        Run only the Phase 24.2.2 microphone-to-AFE feed/fetch soak proof with
        the packed wn9_hiesp WakeNet model and observational VAD. This does not
        enable Xiaozhi handoff, PTT arbitration, playback suppression, UI
        changes, or an automatic reset/rearm policy.

endmenu
```

## components/application/app_hil_test/Kconfig.projbuild
```kconfig
menu "Smart Room target-hardware test coordinators"

    menu "Phase 16 automated HIL test (test profile only)"

        config APP_PHASE16_AUTO_HIL_TEST
            bool "Run bounded Phase-16 automatic arbitration HIL"
            default n
            depends on !AUDIO_MANAGER_PUBLIC_API_TEST
            help
                Starts one default-off coordinator only after the production
                audio manager, capture/playback arbiters, and voice stack
                reach their normal startup boundary. It uses only public
                arbitration APIs and copied status snapshots; it does not use
                GPIO/PTT input or own I2S, DMA, SD file handles, or raw audio
                buffers. Do not enable in a production image.

        config APP_PHASE16_AUTO_HIL_WAV_PATH
            string "Phase-16 automatic HIL WAV path"
            default "/sdcard/audio/input_long.wav"
            depends on APP_PHASE16_AUTO_HIL_TEST
            help
                Existing canonical PCM16 mono 16-kHz WAV on the managed SD
                filesystem. The harness passes this copied path to the public
                playback arbiter; it does not open or write the file itself.

    endmenu

endmenu
```

## components/application/local_web_server/Kconfig
```kconfig
menu "Local Web Server"

config LOCAL_WEB_SERVER_ENABLE
    bool "Enable local Storage Web UI"
    default y
    help
        Starts the local HTTP Storage UI only after the application has an
        online network handoff. It provides bounded SD browsing and transfer
        controls, but never configures or controls Wi-Fi.

endmenu
```

## components/application/wake_word_manager/Kconfig
```kconfig
menu "Wake word manager"

config WAKE_WORD_ENABLE
    bool "Enable local WakeNet Hi ESP detector"
    default n
    depends on IDF_TARGET_ESP32S3
    select SR_WN_WN9_HIESP
    help
        Build the standalone local WakeNet9 Hi ESP detector. It consumes only
        copied PCM from audio_manager and does not start Xiaozhi, PTT, or a
        conversation.

endmenu
```

## components/application/xiaozhi_foundation/Kconfig
```kconfig
menu "Xiaozhi foundation"

config SMART_ROOM_XIAOZHI_FIRST_BOOT_ACTIVATION
    bool "Enable Xiaozhi first-boot activation flow"
    default y
    help
        Read the managed Xiaozhi get_info activation response before starting
        the WebSocket session. When the backend requests activation, keep the
        product running, publish a bounded copied activation snapshot, and
        retry from the voice lifecycle task. Disable only to retain the
        pre-activation session behavior for compatibility testing.

endmenu
```

## components/application/xiaozhi_foundation/Kconfig.projbuild
```kconfig
menu "Xiaozhi Phase 12 validation"

config XIAOZHI_FOUNDATION_VALIDATION_ENABLE
    bool "Enable temporary Phase 12 Xiaozhi validation runtime"
    default n
    help
        Enable the temporary Phase 12 Xiaozhi validation runtime. This is not
        the future production voice assistant. When disabled, normal Gateway
        startup and network routing do not automatically start Xiaozhi
        validation. P2-E and P2-F options are meaningful only while this
        validation gate is enabled.

config XIAOZHI_FOUNDATION_P2F_EMBED_FIXTURE
    bool "Embed the optional P2-F known-audio fixture"
    depends on XIAOZHI_FOUNDATION_VALIDATION_ENABLE
    default n
    help
        Embed test_assets/p2f_fixture.bin only for Phase 12.5 P2-F hardware
        validation. The asset is not a production audio input and is disabled
        by default. The build fails clearly if this option is enabled without
        the documented fixture file.

config XIAOZHI_FOUNDATION_P2F_E2E_ONLINE_VALIDATION
    bool "Run P2-F known-audio E2E instead of default P2-E"
    depends on XIAOZHI_FOUNDATION_VALIDATION_ENABLE
    depends on XIAOZHI_FOUNDATION_P2F_EMBED_FIXTURE
    default n
    help
        At the next application ONLINE transition, run the independent P2-F
        WebSocket audio/STT/TTS validation. Leave this disabled to run the
        default P2-E audio-channel lifecycle validation.

config XIAOZHI_FOUNDATION_P26_LIFECYCLE_MATRIX
    bool "Run Phase 12.6 repeated lifecycle matrix"
    depends on XIAOZHI_FOUNDATION_VALIDATION_ENABLE
    depends on !XIAOZHI_FOUNDATION_P2F_E2E_ONLINE_VALIDATION
    default n
    help
        Run the Phase 12.6 WebSocket lifecycle matrix after the next
        application ONLINE transition. Each cycle owns a new Xiaozhi context,
        EventGroup, event handler, chat handle, MCP engine, counters, and
        resource snapshots. The matrix uses the P2-E audio-channel lifecycle
        for every cycle and stops after the first failure. It is validation
        infrastructure only; it does not enable a production voice feature.

config XIAOZHI_FOUNDATION_P26_LIFECYCLE_CYCLE_COUNT
    int "Phase 12.6 lifecycle matrix cycle count"
    depends on XIAOZHI_FOUNDATION_P26_LIFECYCLE_MATRIX
    range 1 100
    default 1
    help
        Number of full WebSocket init/start/connected/open-close/stop/deinit
        cycles requested for one explicit Phase 12.6 run. Start with 1, then
        progress through 3, 10, 20, and 100 only after target evidence is
        clean. The worker stops at the first failed cycle.

config XIAOZHI_FOUNDATION_P26_FAULT_MATRIX
    bool "Run Phase 12.6 controlled fault/recovery matrix"
    depends on XIAOZHI_FOUNDATION_VALIDATION_ENABLE
    depends on !XIAOZHI_FOUNDATION_P2F_E2E_ONLINE_VALIDATION
    depends on !XIAOZHI_FOUNDATION_P26_LIFECYCLE_MATRIX
    default n
    help
        Run one explicitly selected, project-controlled lifecycle abort followed
        by one clean P2-E recovery lifecycle. The injection never changes
        private esp_xiaozhi state, Wi-Fi ownership, provisioning, NVS, cloud,
        LVGL, or audio hardware. This is validation-only infrastructure and is
        disabled in normal Gateway operation.

choice XIAOZHI_FOUNDATION_P26_FAULT_SELECTOR
    prompt "Phase 12.6 controlled fault selector"
    depends on XIAOZHI_FOUNDATION_P26_FAULT_MATRIX
    default XIAOZHI_FOUNDATION_P26_FAULT_SELECTOR_NONE
    help
        Select a deterministic project-owned lifecycle boundary. NONE leaves
        injection disabled. ALL_SUPPORTED runs each safe boundary serially and
        stops after the first unexpected result or failed recovery.

config XIAOZHI_FOUNDATION_P26_FAULT_SELECTOR_NONE
    bool "None (do not inject a fault)"

config XIAOZHI_FOUNDATION_P26_FAULT_SELECTOR_AFTER_GET_INFO
    bool "Abort after Xiaozhi service info acquisition"

config XIAOZHI_FOUNDATION_P26_FAULT_SELECTOR_AFTER_MCP_CREATE
    bool "Abort after MCP engine creation"

config XIAOZHI_FOUNDATION_P26_FAULT_SELECTOR_AFTER_EVENT_GROUP_CREATE
    bool "Abort after validation EventGroup creation"

config XIAOZHI_FOUNDATION_P26_FAULT_SELECTOR_AFTER_CHAT_INIT
    bool "Abort after chat initialization"

config XIAOZHI_FOUNDATION_P26_FAULT_SELECTOR_AFTER_EVENT_HANDLER_REGISTER
    bool "Abort after ESP event-handler registration"

config XIAOZHI_FOUNDATION_P26_FAULT_SELECTOR_AFTER_CHAT_START
    bool "Abort after chat start"

config XIAOZHI_FOUNDATION_P26_FAULT_SELECTOR_AFTER_AUDIO_CHANNEL_OPEN
    bool "Abort after P2-E audio-channel open"

config XIAOZHI_FOUNDATION_P26_FAULT_SELECTOR_ALL_SUPPORTED
    bool "Run all supported controlled fault cases"

endchoice

endmenu
```

## components/audio/audio_manager/Kconfig
```kconfig
menu "Audio manager"

    config AUDIO_MANAGER_MANUAL_RECORD_MAX_SECONDS
        int "Maximum manual recording duration (seconds)"
        range 1 120
        default 30
        help
            Compile-time upper bound for audio_manager_start_recording().
            Manual capture stops when the application requests stop or this
            duration is reached, whichever happens first. The manager allocates
            one shared retained-recording PSRAM buffer large enough for the
            larger of this limit and the fixed record_duration_seconds value.

    config AUDIO_MANAGER_WAV_PREFETCH_SECONDS
        int "WAV prefetch block duration (seconds)"
        range 1 30
        default 10
        help
            Each logical WAV prefetch block holds this many seconds of the
            accepted PCM16 mono 16-kHz source. At the default, one block is
            320000 bytes and the two PSRAM ping-pong blocks use 640000 bytes
            only while a WAV is active. The SD reader still uses bounded 4 KiB
            raw reads. The I2S-owning manager consumes only a READY block and
            applies its fixed PCM16 full-scale-to-output-ceiling map during TX;
            no whole-file WAV scan or source-file modification is performed.

endmenu
```

## components/output/light_manager/Kconfig
```kconfig
menu "Light manager"

    config LIGHT_MANAGER_TEST_LOOP
        bool "Run infinite NeoPixel light-manager API/effect test loop"
        default n
        help
            Starts a target-hardware-only task immediately after successful
            light_manager initialization. The task loops forever through the
            five public Smart Room effects, their state snapshots, a solid
            restore, and blink OFF/ON resumption, logging each action and
            waiting eight seconds between actions.

            This is validation infrastructure, not product behavior. Keep it
            disabled in normal firmware. It does not add MCP, GUI, cloud, or
            named-color behavior.

    config LIGHT_MANAGER_TEST_STEP_DELAY_MS
        int "Light-manager test step delay (milliseconds)"
        range 1000 60000
        default 8000
        depends on LIGHT_MANAGER_TEST_LOOP
        help
            Delay after every test action. The default is eight seconds so a
            single onboard NeoPixel can be observed between serial log steps.

endmenu
```

## components/system/log_manager/Kconfig
```kconfig
menu "Application log manager"
    config LOG_MANAGER_ENABLE
        bool "Enable persistent application logger"
        depends on SPIRAM
        default y
    config LOG_MANAGER_BUFFER_KIB
        int "PSRAM ring size (KiB)"
        range 16 2048
        default 512
    config LOG_MANAGER_RECORD_BYTES
        int "Maximum record bytes (including newline and terminator)"
        range 256 1024
        default 512
    config LOG_MANAGER_WRITE_BYTES
        int "Batch write threshold (bytes)"
        range 1024 16384
        default 4096
    config LOG_MANAGER_WRITE_MS
        int "Maximum batch delay (ms)"
        range 100 10000
        default 1000
    config LOG_MANAGER_SYNC_MS
        int "Durability sync interval (ms)"
        range 1000 60000
        default 5000
    config LOG_MANAGER_ROTATE_KIB
        int "Maximum file size (KiB)"
        range 64 65536
        default 5120
    config LOG_MANAGER_RETAIN_MIB
        int "Maximum retained log data (MiB)"
        range 8 2048
        default 256
    config LOG_MANAGER_CONSOLE_LEVEL
        int "Console level (0=none, 1=error through 5=verbose)"
        range 0 5
        default 3
    config LOG_MANAGER_STORAGE_LEVEL
        int "Persistent level (0=none, 1=error through 5=verbose)"
        range 0 5
        default 4
endmenu
```

## components/system/performance_monitor/Kconfig
```kconfig
menu "Performance monitor"

config PERFORMANCE_MONITOR_ENABLE
    bool "Enable runtime performance monitor"
    default y
    depends on FREERTOS_GENERATE_RUN_TIME_STATS
    help
        Start the low-priority performance monitor during Smart Room product
        boot. It periodically logs CPU, Internal RAM, PSRAM, DMA-capable RAM,
        application partition use, and task stack high-water marks.

        Disable this option when a production deployment does not require
        periodic diagnostic logging.

endmenu
```
